/*
 * Opcional: consola por el puerto USB nativo (USB-Serial-JTAG).
 * Uso: west build ... -- -DEXTRA_DTC_OVERLAY_FILE=boards/usb_console.overlay
 */
/ {
	chosen {
		zephyr,console = &usb_serial;
		zephyr,shell-uart = &usb_serial;
	};
};

&usb_serial {
	status = "okay";
};
