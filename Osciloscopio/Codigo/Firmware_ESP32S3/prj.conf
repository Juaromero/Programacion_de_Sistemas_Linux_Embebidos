## prj.conf
```kconfig
# Osciloscopio ESP32-S3 - configuracion Zephyr

# Consola (se redirige al USB-Serial-JTAG en boards/*.overlay)
CONFIG_CONSOLE=y
CONFIG_SERIAL=y
CONFIG_UART_CONSOLE=y
CONFIG_PRINTK=y

# ADC con DMA (rafagas con intervalo constante entre conversiones)
CONFIG_ADC=y
CONFIG_ADC_ESP32_DMA=y
CONFIG_HEAP_MEM_POOL_SIZE=16384

# SPI en modo esclavo (target)
CONFIG_SPI=y
CONFIG_SPI_ESP32_INTERRUPT=y
CONFIG_ESP32_SPI_TARGET=y

# CRC-16 (CRC-16/CCITT-FALSE = crc16_itu_t con semilla 0xFFFF)
CONFIG_CRC=y

# Resolucion del tick: 100 us (necesario para el preset de 100 Sa/s)
CONFIG_SYS_CLOCK_TICKS_PER_SEC=10000

CONFIG_MAIN_STACK_SIZE=2048
```

## src/acq.h
```c
/* Adquisicion de 2 canales (ADC1: GPIO1 y GPIO2) en ventanas de 64 muestras.
 * Cada canal tiene su propio preset y se puede activar o desactivar. */
#ifndef OSC_ACQ_H
#define OSC_ACQ_H

#include <stdint.h>
#include "protocol.h"

#define ACQ_BOTH 2u   /* indice de canal especial: aplicar a los dos */

struct acq_stats {
	uint32_t windows;       /* ventanas publicadas */
	uint32_t errors;        /* errores del ADC */
	uint32_t last_win_us;   /* duracion de la ultima adquisicion (incluye arranque) */
	struct osc_win_info info;  /* presets, fs, mascara y alineacion actuales */
};

int  acq_init(void);
void acq_request_preset(uint8_t ch, uint8_t preset);  /* ch: 0, 1 o ACQ_BOTH */
void acq_request_mask(uint8_t mask);                  /* bit0 = CH1, bit1 = CH2 */
uint8_t acq_get_mask(void);
uint32_t acq_preset_fs(uint8_t preset);
void acq_get_stats(struct acq_stats *out);
/* Copia la ultima ventana (para el monitor serie). Devuelve wseq. */
uint16_t acq_copy_last(uint16_t d1[OSC_WIN_SAMPLES], uint16_t d2[OSC_WIN_SAMPLES],
		       struct osc_win_info *info);
void acq_thread_fn(void *a, void *b, void *c);
void acq_dump_dma(void);   /* diagnostico: entradas DMA crudas de la ultima rafaga */

#endif
```

## src/protocol.h
```c
/*
 * Protocolo SPI ESP32-S3 (esclavo) <-> Raspberry Pi (maestro).
 * Especificacion completa: Osciloscopio/Documentos/Latex/03_Protocolo_SPI.tex
 *
 * El FIFO del esclavo SPI del ESP32-S3 en Zephyr admite 64 bytes por
 * activacion de CS, por lo que una ventana (280 bytes de "stream") viaja en
 * 5 segmentos de 64 bytes, uno por transaccion SPI.
 */
#ifndef OSC_PROTOCOL_H
#define OSC_PROTOCOL_H

#include <stdint.h>
#include <stddef.h>

/* ---- Geometria de la ventana (stream version 2) ----
 * [0] version=2 [1] mascara de canales [2] bits [3] flags (bit0 = sincronizados)
 * [4..5] n=64 [6] preset CH1 [7] preset CH2 [8..11] fs CH1 [12..15] fs CH2
 * [16..143] CH1: 64 x uint16   [144..271] CH2: 64 x uint16   [272..279] relleno */
#define OSC_WIN_SAMPLES   64u   /* muestras por canal */
#define OSC_NCH           2u
#define OSC_ADC_BITS      12u
#define OSC_STREAM_VER    2u
#define OSC_WINHDR_LEN    16u
#define OSC_FLAG_ALIGNED  0x01u
#define OSC_DATA_LEN      (OSC_WIN_SAMPLES * OSC_NCH * 2u)       /* 256 */

/* ---- Segmento SPI (64 bytes) ---- */
#define OSC_SEG_LEN       64u
#define OSC_SEG_HDR       6u    /* sync, idx, wseq(2), preset, cmd_ack */
#define OSC_SEG_PAYLOAD   56u
#define OSC_SEG_CRC_OFF   62u
#define OSC_NSEG          5u
#define OSC_STREAM_LEN    (OSC_SEG_PAYLOAD * OSC_NSEG)           /* 280 */

#define OSC_SYNC_TX       0xA5u /* ESP32 -> RPi */
#define OSC_SYNC_RX       0x5Au /* RPi -> ESP32 */
#define OSC_SEG_IDLE      0xFFu /* aun no hay ventana disponible */

/* ---- Comandos (RPi -> ESP32), primeros 8 bytes de la transaccion ---- */
#define OSC_CMD_NOP         0x00u
#define OSC_CMD_SET_PRESET  0x01u
#define OSC_CMD_RESYNC      0x02u
#define OSC_CMD_SET_CH_PRESET 0x03u /* arg = (canal << 4) | preset, canal 0 o 1 */
#define OSC_CMD_SET_MASK    0x04u   /* arg = mascara: bit0 CH1, bit1 CH2 */
#define OSC_CMD_LEN         8u  /* sync, cmd, arg, cmd_seq, rsv(2), crc(2) */

/* ---- Presets ---- */
#define OSC_NPRESETS      5u    /* 100, 1k, 10k, 41.7k y 83.3k Sa/s (este, un canal por rafaga) */

/* Descripcion de una ventana */
struct osc_win_info {
	uint32_t fs[OSC_NCH];     /* Sa/s por canal */
	uint8_t  preset[OSC_NCH];
	uint8_t  mask;            /* canales adquiridos */
	uint8_t  aligned;         /* 1 = CH1 y CH2 de la misma rafaga */
};

/* Slot de ventana (3 slots en anillo: acquisition escribe, SPI lee). */
struct osc_slot {
	uint8_t  stream[OSC_STREAM_LEN]; /* winhdr + datos + relleno */
	uint16_t wseq;
	uint8_t  preset;                 /* preset de CH1 (campo PRESET del segmento) */
};

uint16_t osc_crc16(const uint8_t *data, size_t len);

/* Construye el stream (version 2) de una ventana con los datos de cada canal. */
void osc_slot_fill(struct osc_slot *s, const uint16_t *d1, const uint16_t *d2,
		   const struct osc_win_info *info, uint16_t wseq);

/* Genera el segmento idx (0..4) del slot; con s == NULL genera IDLE. */
void osc_segment_build(uint8_t out[OSC_SEG_LEN], const struct osc_slot *s,
		       uint8_t idx, uint8_t cmd_ack);

/* Valida y decodifica un comando recibido. Devuelve 0 si es valido. */
int osc_cmd_parse(const uint8_t *rx, uint8_t *cmd, uint8_t *arg, uint8_t *seq);

/* Gestion de slots (anillo de 3). Devuelve indices 0..2 o -1. */
int osc_slot_get_free(void);
void osc_slot_publish(int idx);
int osc_slot_lock_latest(void);   /* marca el ultimo slot como en uso */
void osc_slot_unlock(void);
struct osc_slot *osc_slot_ptr(int idx);

#endif /* OSC_PROTOCOL_H */
```

## src/spi_link.c
```c
/*
 * Esclavo SPI (spi2, modo 0, 8 bits). Cada transaccion es de 64 bytes:
 *   MISO: segmento de la ventana (ver protocol.h)
 *   MOSI: comando de la RPi (primeros 8 bytes), el resto se ignora
 * El esclavo no puede iniciar transferencias: despues de cada transaccion
 * prepara el siguiente segmento y se rearma. La RPi debe respetar un tiempo
 * minimo entre transacciones (gap) para que el esclavo alcance a rearmarse.
 *
 * Una ventana se sirve completa (5 segmentos) desde un unico slot "congelado",
 * asi que no se envia una ventana nueva hasta terminar de entregar la actual
 * (RNF-06). Al terminar, el siguiente ciclo toma la ventana mas reciente.
 */
#include <string.h>
#include <zephyr/kernel.h>
#include <zephyr/drivers/spi.h>
#include <zephyr/sys/atomic.h>

#include "spi_link.h"
#include "protocol.h"
#include "acq.h"

static const struct device *const spi_dev = DEVICE_DT_GET(DT_NODELABEL(spi2));

static const struct spi_config spi_cfg = {
	.operation = SPI_OP_MODE_PERIPHERAL | SPI_WORD_SET(8) | SPI_TRANSFER_MSB,
};

static struct spi_stats stats;
static uint8_t cmd_ack;       /* ultimo cmd_seq ejecutado */
static uint8_t tx_buf[OSC_SEG_LEN];
static uint8_t rx_buf[OSC_SEG_LEN];

int spi_link_init(void)
{
	if (!device_is_ready(spi_dev)) {
		printk("SPI esclavo no listo\n");
		return -ENODEV;
	}
	return 0;
}

void spi_link_get_stats(struct spi_stats *out)
{
	*out = stats;
}

static void handle_command(bool *resync)
{
	uint8_t cmd, arg, seq;

	if (osc_cmd_parse(rx_buf, &cmd, &arg, &seq) != 0) {
		/* Un maestro que no envia comando (MOSI = 0x00) no es un error */
		if (rx_buf[0] != 0x00 && rx_buf[0] != 0xFF) {
			stats.cmd_bad++;
		}
		return;
	}
	stats.cmd_ok++;
	if (cmd == OSC_CMD_NOP || seq == cmd_ack) {
		return; /* sin comando o repeticion de uno ya ejecutado */
	}
	if (cmd == OSC_CMD_SET_PRESET) {
		acq_request_preset(ACQ_BOTH, arg);         /* los dos canales */
		cmd_ack = seq;
	} else if (cmd == OSC_CMD_SET_CH_PRESET) {
		acq_request_preset((arg >> 4) & 0x1, arg & 0x0F);
		cmd_ack = seq;
	} else if (cmd == OSC_CMD_SET_MASK) {
		acq_request_mask(arg & 0x3);
		cmd_ack = seq;
	} else if (cmd == OSC_CMD_RESYNC) {
		*resync = true;
		stats.resyncs++;
		cmd_ack = seq;
	}
}

void spi_link_thread_fn(void *a, void *b, void *c)
{
	ARG_UNUSED(a); ARG_UNUSED(b); ARG_UNUSED(c);
	uint8_t next_seg = 0;
	int slot = -1;

	for (;;) {
		if (next_seg == 0) {
			/* Inicio de ciclo: congelar la ventana mas reciente */
			osc_slot_unlock();
			slot = osc_slot_lock_latest();
		}
		osc_segment_build(tx_buf, slot >= 0 ? osc_slot_ptr(slot) : NULL,
				  next_seg, cmd_ack);

		const struct spi_buf txb = { .buf = tx_buf, .len = OSC_SEG_LEN };
		const struct spi_buf rxb = { .buf = rx_buf, .len = OSC_SEG_LEN };
		const struct spi_buf_set txs = { .buffers = &txb, .count = 1 };
		const struct spi_buf_set rxs = { .buffers = &rxb, .count = 1 };

		int n = spi_transceive(spi_dev, &spi_cfg, &txs, &rxs);

		if (n < 0 || n < (int)OSC_SEG_LEN) {
			stats.partial++;
			continue; /* no avanzar: se reintenta el mismo segmento */
		}
		stats.transactions++;

		bool resync = false;

		handle_command(&resync);
		if (resync) {
			next_seg = 0;
		} else {
			next_seg = (next_seg + 1) % OSC_NSEG;
		}
	}
}
```
